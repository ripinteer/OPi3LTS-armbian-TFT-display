/dts-v1/;
/plugin/;

/ {
	compatible = "allwinner,sun50i-h6";
	
		fragment@0 {
			target-path = "/aliases";
			__overlay__ {
				spi0 = "/soc/spi@5010000";
				spi1 = "/soc/spi@5011000";
			};
		};


		fragment@1 {
			target = <&spi1>;
			__overlay__ {
				#address-cells = <1>;
				#size-cells = <0>;
				status = "okay";
    	        spidev@1 {
    	        	reg = <1>; /* Chip Select 0 */
    	        	compatible = "spidev";
    	        	spi-max-frequency = <50000000>;
    	        	status = "okay";
    	    	};
    	    };
		};
};